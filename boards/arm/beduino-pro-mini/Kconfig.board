## boards/arm/beduino-pro-mini/Kconfig.board
```kconfig
# Kconfig - Beduino Pro Mini board
#
# Copyright (c) 2019, Tristan Bruns
#
# SPDX-License-Identifier: Apache-2.0
#

config BOARD_BEDUINO_PRO_MINI
	bool "Beduino Pro Mini"
	depends on SOC_SERIES_KINETIS_KWX
	select SOC_PART_NUMBER_MKW41Z256VHT4
```

## boards/arm/beduino-pro-mini/Kconfig.defconfig
```kconfig
# Kconfig - Beduino Pro Mini board
#
# Copyright (c) 2019, Tristan Bruns
#
# SPDX-License-Identifier: Apache-2.0
#

if BOARD_BEDUINO_PRO_MINI

config BOARD
	default "beduino_pro_mini"

config OSC_XTAL0_FREQ
	default 32000000

config MCG_FRDIV
	default 5

config MCG_FCRDIV
	default 0

if PINMUX_MCUX

config PINMUX_MCUX_PORTA
	default y

config PINMUX_MCUX_PORTB
	default y

config PINMUX_MCUX_PORTC
	default y

endif # PINMUX_MCUX

if GPIO_MCUX

config GPIO_MCUX_PORTA
	default y

config GPIO_MCUX_PORTB
	default y

config GPIO_MCUX_PORTC
	default n

endif # GPIO_MCUX

if UART_MCUX_LPUART

config UART_MCUX_LPUART_0
	default y if UART_CONSOLE

endif # UART_MCUX

if I2C

config I2C_1
	default y

endif # I2C

if ADC

config ADC_0
	default n

endif # ADC

if SPI

config SPI_0
	default y

endif # SPI

endif # BOARD_BEDUINO_PRO_MINI
```
